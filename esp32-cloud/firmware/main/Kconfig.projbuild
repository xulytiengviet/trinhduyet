## esp32-cloud/firmware/main/Kconfig.projbuild
```kconfig
menu "TrinhDuyet ESP32 Cloud"
    config ESP32_CLOUD_WIFI_SSID
        string "WiFi SSID"
        default ""
    config ESP32_CLOUD_WIFI_PASSWORD
        string "WiFi password"
        default ""
    config ESP32_CLOUD_API_URL
        string "Render API HTTPS origin (no trailing slash)"
        default ""
    config ESP32_CLOUD_DEVICE_ID
        string "Device UUID (issued by Google dashboard)"
        default ""
    config ESP32_CLOUD_DEVICE_KEY
        string "Device secret key (issued once)"
        default ""
    config ESP32_CLOUD_VERSION
        string "Firmware version"
        default "0.1.0"
    config ESP32_CLOUD_BOARD
        string "Board identifier (ESP32/ESP32-S3/ESP32-C3/ESP32-C6)"
        default "ESP32-S3"
endmenu
```
